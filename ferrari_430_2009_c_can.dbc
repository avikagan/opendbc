VERSION ""

NS_ :

BS_:

BU_:

BO_ 1121 MM_TCU_3: 8 Vector__XXX

BO_ 1120 MM_TCU_2: 8 Vector__XXX

BO_ 1119 MM_TCU_1: 8 Vector__XXX
 SG_ GearPosition : 16|8@1- (1,0) [0|0] "" Vector__XXX

BO_ 1591 Bosch_ME7_6: 8 Vector__XXX

BO_ 1423 Bosch_ME7_5: 8 Vector__XXX

BO_ 1409 Bosch_ME7_4: 8 Vector__XXX

BO_ 892 Bosch_ME7_3: 8 Vector__XXX

BO_ 809 Bosch_ME7_2: 8 Vector__XXX

BO_ 790 Bosch_ME7_1: 8 Vector__XXX

BO_ 390 Bosch_ESP: 8 Vector__XXX
 SG_ Brake_MC_Press : 48|8@1- (1,0) [0|0] "bar" Vector__XXX

BO_ 1311 Bosch_ME7: 8 Vector__XXX
 SG_ Throttle_Position : 16|24@1+ (0.001525,0) [0|0] "%" Vector__XXX

BO_ 192 Steer: 8 XXX
 SG_ SteerAngle : 7|8@0+ (1,0) [0|255] "" XXX

BA_DEF_ SG_  "GenSigSendType" ENUM  "Cyclic","OnWrite","OnWriteWithRepetition","OnChange","OnChangeWithRepetition","IfActive","IfActiveWithRepetition","NoSigSendType";
BA_DEF_ BO_  "GenMsgSendType" ENUM  "Cyclic","not_used","not_used","not_used","not_used","Cyclic","not_used","IfActive","NoMsgSendType";
BA_DEF_  "DBName" STRING ;
BA_DEF_  "BusType" STRING ;
BA_DEF_DEF_  "GenSigSendType" "Cyclic";
BA_DEF_DEF_  "GenMsgSendType" "NoMsgSendType";
BA_DEF_DEF_  "DBName" "";
BA_DEF_DEF_  "BusType" "CAN";
BA_ "DBName" "Ferrari430";
